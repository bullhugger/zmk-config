## config/west.yml
```yaml
manifest:
  remotes:
    - name: zmkfirmware
      url-base: https://github.com/zmkfirmware
    - name: caksoylar
      url-base: https://github.com/caksoylar
  projects:
    - name: zmk
      remote: zmkfirmware
      revision: v0.2-branch
      import: app/west.yml
    - name: zmk-rgbled-widget
      remote: caksoylar
      revision: 194a0f81a38910403337f7669d0f36746815332c
  self:
    path: config
```
